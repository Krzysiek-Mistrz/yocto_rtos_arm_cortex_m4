## meta-mono/conf/distro/imx6ull-linux.conf
```bitbake
DISTRO = "imx6ull-linux"
DISTRO_NAME = "i.MX6ULL Linux Distribution"
DISTRO_VERSION = "1.0"
MAINTAINER = "Embedded Systems Team"

# Use glibc for full Linux system
TCLIBC = "glibc"

# Distribution features for embedded Linux with UART bridge
DISTRO_FEATURES = " \
    alsa \
    bluetooth \
    ext2 \
    ipv4 \
    ipv6 \
    largefile \
    pam \
    systemd \
    usrmerge \
    usbgadget \
    usbhost \
    wifi \
    zeroconf \
"

# Use systemd as init manager
VIRTUAL-RUNTIME_init_manager = "systemd"
VIRTUAL-RUNTIME_initscripts = "systemd-compat-units"
DISTRO_FEATURES_BACKFILL_CONSIDERED = "sysvinit"

# Preferred providers are set by the machine config (imx6ull-ebyte)

# Quality assurance checks
ERROR_QA:append = " textrel host-user-contaminated"
WARN_QA:append = " buildpaths ldflags"

# Image settings
IMAGE_OVERHEAD_FACTOR = "1.3"
EXTRA_IMAGE_FEATURES = "debug-tweaks tools-debug ssh-server-openssh"

# Package management
PACKAGE_CLASSES = "package_rpm"

# SDK settings
SDKMACHINE = "x86_64"

# Enable UART2 for STM32F411 communication
# This will be configured in the device tree
```

## meta-mono/conf/distro/recovery.conf
```bitbake
DISTRO = "recovery"
DISTRO_NAME = "STM32 Recovery RTOS"
DISTRO_VERSION = "2.0"
MAINTAINER = "Embedded Systems Team"

# C library for embedded systems - use newlib (lightweight)
TCLIBC = "newlib"

# Embedded features - minimal footprint with GPIO and interface support
DISTRO_FEATURES = "zephyr gpio i2c spi usb uart"

# Use Zephyr RTOS instead of Linux
VIRTUAL-RUNTIME_init_manager = ""
VIRTUAL-RUNTIME_initscripts = ""

# Embedded utilities
VIRTUAL-RUNTIME_base-utils = ""
VIRTUAL-RUNTIME_login_manager = ""

# Preferred providers for embedded system
PREFERRED_PROVIDER_virtual/kernel = "zephyr-kernel"
PREFERRED_PROVIDER_virtual/libc = "newlib"

# Toolchain settings for ARM Cortex-M4
TCMODE = "external-arm-toolchain"

# Quality assurance checks
ERROR_QA:append = " textrel host-user-contaminated"
WARN_QA:append = " buildpaths ldflags"

# Embedded-specific settings
IMAGE_OVERHEAD_FACTOR = "1.0"
EXTRA_IMAGE_FEATURES = "tools-debug dev-pkgs"
```

## meta-mono/conf/layer.conf
```bitbake
BBPATH .= ":${LAYERDIR}"

BBFILES += "${LAYERDIR}/recipes-*/*/*.bb \
            ${LAYERDIR}/recipes-*/*/*.bbappend"

BBFILE_COLLECTIONS += "meta-mono"
BBFILE_PATTERN_meta-mono = "^${LAYERDIR}/"
BBFILE_PRIORITY_meta-mono = "10"

LAYERDEPENDS_meta-mono = "core"
LAYERSERIES_COMPAT_meta-mono = "scarthgap"

BBFILES_DYNAMIC += " \
    freescale-layer:${LAYERDIR}/dynamic-layers/freescale-layer/*/*/*.bb \
    freescale-layer:${LAYERDIR}/dynamic-layers/freescale-layer/*/*/*.bbappend \
"
```

## meta-mono/conf/machine/imx6ull-ebyte.conf
```bitbake
#@TYPE: Machine
#@NAME: EBYTE i.MX6ULL SoM (ECK20-6Y28C)
#@DESCRIPTION: Machine configuration for EBYTE i.MX6ULL System-on-Module with ECB20-PG6Y28C-I carrier board

# Include i.MX6ULL base configuration
require conf/machine/include/imx-base.inc
require conf/machine/include/arm/armv7a/tune-cortexa7.inc

# Use NXP BSP variant (required for linux-imx provider)
IMX_DEFAULT_BSP = "nxp"

# Machine identification
# Append SoC-specific overrides; imx-base.inc already provides use-${IMX_DEFAULT_BSP}-bsp.
MACHINEOVERRIDES:append = ":mx6:mx6ull:"

# SoC family
SOC_FAMILY = "imx:mx6:mx6ull"

# Kernel configuration
PREFERRED_PROVIDER_virtual/kernel ?= "linux-imx"
KERNEL_IMAGETYPE = "zImage"
KERNEL_DEVICETREE = "imx6ull-ebyte-emmc.dtb"

# U-Boot configuration
PREFERRED_PROVIDER_virtual/bootloader = "u-boot-imx"
PREFERRED_PROVIDER_u-boot = "u-boot-imx"

# IMPORTANT: Use *either* UBOOT_MACHINE *or* UBOOT_CONFIG. Using both causes
# u-boot recipes to be skipped by uboot-config.bbclass which then breaks
# virtual/bootloader.
#
# We use UBOOT_CONFIG so we can easily switch between SD and eMMC builds.
UBOOT_MAKE_TARGET = "u-boot.imx"
UBOOT_SUFFIX = "imx"

UBOOT_CONFIG ??= "sd"
UBOOT_CONFIG[sd]   = "mx6ull_14x14_evk_config,sdcard"
UBOOT_CONFIG[emmc] = "mx6ull_14x14_evk_emmc_config,sdcard"

# Serial console (UART1 for debug console)
SERIAL_CONSOLES = "115200;ttymxc0"

# Machine features
MACHINE_FEATURES = "usbgadget usbhost vfat alsa touchscreen wifi bluetooth serial ethernet"

# Extra features for development
MACHINE_EXTRA_RRECOMMENDS = " \
    kernel-modules \
    linux-firmware \
"

# Image boot files
IMAGE_BOOT_FILES = " \
    ${KERNEL_IMAGETYPE} \
    ${KERNEL_DEVICETREE} \
"

# WIC image configuration for SD card
WKS_FILE = "imx6ull-ebyte.wks"
WKS_FILE_DEPENDS ?= " \
    u-boot-imx \
    e2fsprogs-native \
    bmap-tools-native \
"
IMAGE_FSTYPES = "wic.gz wic.bmap tar.gz"

# EBYTE ECK20-6Y28C specifications:
# - NXP i.MX6ULL (ARM Cortex-A7 @ 900MHz)
# - 512MB DDR3 RAM
# - 8GB eMMC storage
# - 2x Ethernet (10/100 Mbps)
# - USB OTG + USB Host
# - SD Card slot
# - LCD interface (1024x600)
# - Audio codec (ES8316)
# - RTC (DS1307)
# - Multiple UART/I2C/SPI interfaces

# UART2 will be used for STM32F411 communication
# UART1 is reserved for Linux console
```

## meta-mono/conf/machine/stm32f411-dk.conf
```bitbake
#@TYPE: Machine
#@NAME: STM32F411CEU6 Black Pill
#@DESCRIPTION: Machine configuration for STM32F411CEU6 (Black Pill board), based on ARM Cortex-M4F

# Include ARM Cortex-M4 tuning
require conf/machine/include/arm/armv7m/tune-cortexm4.inc

# STM32-specific variables
MACHINE_SOCARCH = "cortexm4"
SOC_FAMILY = "stm32f4:stm32f411"

# Machine features for embedded system
MACHINE_FEATURES = "serial usbdevice gpio i2c spi"

# Kernel/RTOS configuration
PREFERRED_PROVIDER_virtual/kernel ?= "zephyr-recovery"
KERNEL_IMAGETYPE = "zephyr.bin"
# Zephyr handles device tree internally for blackpill_f411ce board

# Serial console configuration (USART1 on PA9/PA10 for Black Pill)
SERIAL_CONSOLES = "115200;ttyUSB0"

# For Zephyr RTOS, we don't use IMAGE_FSTYPES (no filesystem)
# Zephyr kernel outputs (bin, elf, hex) are handled by zephyr.bbclass

# Bootloader settings
PREFERRED_PROVIDER_virtual/bootloader = "u-boot-stm32"

# STM32F411CEU6 specifications (Black Pill)
# - ARM Cortex-M4F @ 100MHz (with FPU)
# - 512KB Flash
# - 128KB SRAM
# - USB OTG FS
# - 48-pin LQFP package
# - Multiple communication interfaces (USART, I2C, SPI)

# Extra image features for recovery and development
EXTRA_IMAGE_FEATURES += "tools-debug tools-sdk"

# Remove initramfs bundling (not typical for embedded systems)
INITRAMFS_IMAGE = ""
INITRAMFS_IMAGE_BUNDLE = "0"
```

## meta-mono/meta-mono-zephyr/conf/layer.conf
```bitbake
# Zephyr-only extension layer for the mono project
#
# This layer exists to avoid breaking the i.MX6ULL Linux build:
# - meta-mono is included in both Linux and Zephyr builds
# - Some bbappends only make sense when meta-zephyr is in BBLAYERS
#   (e.g. zephyr-kernel-src.bbappend)
# Keeping those bbappends in this dedicated layer prevents BitBake from
# erroring out during parsing when building Linux-only configs.

BBPATH .= ":${LAYERDIR}"

# Only pick up the zephyr-kernel bbappends from this layer
BBFILES += "${LAYERDIR}/recipes-kernel/zephyr-kernel/*.bbappend"

BBFILE_COLLECTIONS += "meta-mono-zephyr"
BBFILE_PATTERN_meta-mono-zephyr = "^${LAYERDIR}/"
BBFILE_PRIORITY_meta-mono-zephyr = "11"

# This layer is only meaningful when meta-zephyr is present
LAYERDEPENDS_meta-mono-zephyr = "core zephyrcore"

LAYERSERIES_COMPAT_meta-mono-zephyr = "scarthgap"
```

## meta-mono/recipes-kernel/zephyr/files/stm32f411_defconfig
```kconfig
# Zephyr Kernel Configuration for STM32F411
# ARM Cortex-M4 @ 100MHz, 512KB Flash, 128KB RAM

# Architecture
CONFIG_ARM=y
CONFIG_CPU_CORTEX_M=y
CONFIG_CPU_CORTEX_M4=y
CONFIG_ARM_MPU=y
CONFIG_FPU=y
CONFIG_FPU_SHARING=y

# Platform
CONFIG_SOC_FAMILY_STM32=y
CONFIG_SOC_SERIES_STM32F4X=y
CONFIG_SOC_STM32F411XE=y

# Board
CONFIG_BOARD_STM32F411_DK=y

# Clock Configuration
CONFIG_SYS_CLOCK_HW_CYCLES_PER_SEC=100000000
CONFIG_CLOCK_CONTROL=y
CONFIG_CLOCK_STM32_HSE_CLOCK=8000000
CONFIG_CLOCK_STM32_SYSCLK_SRC_PLL=y
CONFIG_CLOCK_STM32_PLL_M_DIVISOR=8
CONFIG_CLOCK_STM32_PLL_N_MULTIPLIER=200
CONFIG_CLOCK_STM32_PLL_P_DIVISOR=2
CONFIG_CLOCK_STM32_AHB_PRESCALER=1
CONFIG_CLOCK_STM32_APB1_PRESCALER=2
CONFIG_CLOCK_STM32_APB2_PRESCALER=1

# Kernel Options
CONFIG_MULTITHREADING=y
CONFIG_NUM_PREEMPT_PRIORITIES=15
CONFIG_MAIN_STACK_SIZE=2048
CONFIG_IDLE_STACK_SIZE=512
CONFIG_THREAD_STACK_INFO=y
CONFIG_THREAD_MONITOR=y

# Memory Management
CONFIG_HEAP_MEM_POOL_SIZE=16384
CONFIG_MINIMAL_LIBC_MALLOC_ARENA_SIZE=8192

# Console and Shell
CONFIG_CONSOLE=y
CONFIG_UART_CONSOLE=y
CONFIG_SERIAL=y
CONFIG_SHELL=y
CONFIG_SHELL_BACKEND_SERIAL=y
CONFIG_SHELL_PROMPT_UART="stm32:~$ "
CONFIG_SHELL_CMD_BUFF_SIZE=256
CONFIG_SHELL_PRINTF_BUFF_SIZE=256

# GPIO Support
CONFIG_GPIO=y
CONFIG_GPIO_STM32=y
CONFIG_GPIO_SHELL=y

# UART/USART Support
CONFIG_UART_STM32=y
CONFIG_UART_INTERRUPT_DRIVEN=y
CONFIG_UART_LINE_CTRL=y

# I2C Support
CONFIG_I2C=y
CONFIG_I2C_STM32=y
CONFIG_I2C_SHELL=y
CONFIG_I2C_SLAVE=y

# SPI Support
CONFIG_SPI=y
CONFIG_SPI_STM32=y
CONFIG_SPI_STM32_INTERRUPT=y

# USB Support
CONFIG_USB_DEVICE_STACK=y
CONFIG_USB_DEVICE_PRODUCT="STM32F411 Recovery Device"
CONFIG_USB_DEVICE_VID=0x0483
CONFIG_USB_DEVICE_PID=0x5740
CONFIG_USB_CDC_ACM=y
CONFIG_USB_MASS_STORAGE=n

# ADC Support
CONFIG_ADC=y
CONFIG_ADC_STM32=y

# PWM Support
CONFIG_PWM=y
CONFIG_PWM_STM32=y

# Watchdog
CONFIG_WATCHDOG=y
CONFIG_IWDG_STM32=y

# Flash and Storage
CONFIG_FLASH=y
CONFIG_FLASH_MAP=y
CONFIG_FLASH_PAGE_LAYOUT=y
CONFIG_STM32_FLASH_PREFETCH=y

# File Systems (minimal)
CONFIG_FILE_SYSTEM=y
CONFIG_FILE_SYSTEM_LITTLEFS=y

# Networking (optional, can be disabled to save space)
CONFIG_NETWORKING=n

# Logging
CONFIG_LOG=y
CONFIG_LOG_DEFAULT_LEVEL=3
CONFIG_LOG_PRINTK=y
CONFIG_LOG_BACKEND_UART=y

# Debugging
CONFIG_DEBUG=y
CONFIG_DEBUG_INFO=y
CONFIG_THREAD_NAME=y
CONFIG_ASSERT=y
CONFIG_ASSERT_LEVEL=2

# System
CONFIG_REBOOT=y
CONFIG_SYSTEM_WORKQUEUE_STACK_SIZE=2048

# Timers
CONFIG_TIMER=y
CONFIG_COUNTER=y

# Interrupt Controller
CONFIG_GEN_IRQ_VECTOR_TABLE=y

# Boot
CONFIG_BOOT_BANNER=y
CONFIG_BOOT_DELAY=0

# Application-specific features
CONFIG_PRINTK=y
CONFIG_EARLY_CONSOLE=y

# Recovery-specific features
CONFIG_FLASH_SHELL=y
CONFIG_DEVICE_SHELL=y
CONFIG_KERNEL_SHELL=y

# Size optimizations
CONFIG_SIZE_OPTIMIZATIONS=y
CONFIG_COMPILER_OPT="-Os"

# Disable unused features to save space
CONFIG_CPLUSPLUS=n
CONFIG_MINIMAL_LIBC=y
CONFIG_STDOUT_CONSOLE=y
```
